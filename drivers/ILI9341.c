/*
 *  ILI9341 Driver for TM4C123GXL
 *              ILI9341
 *
 *                       T_IRQ: --
 *                        T_DO: -
 *                       T_DIN: -
 *  SD_SCK: PB4           T_CS: -
 * SD_MISO: PB6          T_CLK: -
 * SD_MOSI: PB7           MISO: -
 *   SD_CS: PB5            LED: 3.3V
 *                         SCK: PB4
 *                        MOSI: PB7
 *                          DC: PA6
 *                       RESET: PE5
 *                          CS: PA3
 *                         GND: GND
 *                         VCC: 3.3V

 */

#include "RTOS/OS.h"
#include "str-utils.h"
#include "drivers/ILI9341.h"
#include "vware/tm4c123gh6pm.h"
#include "vware/hw_memmap.h"
#include "driverlib/gpio.h"
#include "driverlib/sysctl.h"

#define TFT_CS                  (*((volatile uint32_t *)0x40004020)) // PA3
#define TFT_CS_LOW              0           // CS normally controlled by hardware
#define TFT_CS_HIGH             0x08
#define DC                      (*((volatile uint32_t *)0x40004100)) // PA6
#define DC_COMMAND              0
#define DC_DATA                 0x40
#define RESET                   (*((volatile uint32_t *)0x40024080))
#define RESET_LOW               0
#define RESET_HIGH              0x20

#define DELAY 0x80

extern void
Delay1ms(uint32_t n);

void
endSPITransaction();

Sema4Type SPIFree;       // used for mutual exclusion

static const uint8_t cmd_ili9341[] = { 25,
ILI9341_SWRESET, DELAY,
        150, // Software reset

        0xCB, 5, 0x39, 0x2C, 0x00, 0x34, 0x02, 0xCF, 3, 0x00, 0xC1, 0x30, 0xEF,
        3, 0x03, 0x80, 0x02, 0xE8, 3, 0x85, 0x00, 0x78, 0xEA, 2, 0x00, 0x00,
        0xCF, 3, 0x00, 0XC1, 0X30, 0xED, 4, 0x64, 0x03, 0x12, 0x81, 0xF7, 1,
        0x20,

        ILI9341_PWCTRL1, 1,
        0x23, // Power control
        ILI9341_PWCTRL2, 1,
        0x10, // Power control
        ILI9341_VMCTRL1, 2, 0x3E,
        0x28, //0x3e, 0x28, // VCM control
        ILI9341_VMCTRL2, 1,
        0x86, // VCM control2
        ILI9341_MADCTL, 1,
        0x48, // Memory Access Control
        ILI9341_PIXFMT, 1,
        0x55, //16-bit    0x66 24-bit
        ILI9341_INVOFF, 0,
        ILI9341_FRMCTR1, 2, 0x00,
        0x10, // FrameRate Control 119Hz
        ILI9341_DISCTRL, 4, 0x08, 0x82, 0x27,
        0x00, // Display Function Control
        0x30, 4, 0x00, 0x00, 0x01, 0x3F, 0xF2, 1, 0x00,
        ILI9341_GAMMASET, 1,
        0x01, // Gamma curve selected
        ILI9341_GMCTRP1, 15, 0x0F, 0x31, 0x2B, 0x0C, 0x0E, 0x08, 0x4E, 0xF1,
        0x37, 0x07, 0x10, 0x03, 0x0E, 0x09,
        0x00, // Set Gamma
        ILI9341_GMCTRN1, 15, 0x00, 0x0E, 0x14, 0x03, 0x11, 0x07, 0x31, 0xC1,
        0x48, 0x08, 0x0F, 0x0C, 0x31, 0x36, 0x0F, // Set Gamma
        ILI9341_SLPOUT, DELAY, 200,  // Normal display on, 10ms delay
        ILI9341_DISPON, DELAY, 100 };

static const uint8_t Font[] =
        { 0x00, 0x00, 0x00, 0x00, 0x00, 0x3E, 0x5B, 0x4F, 0x5B, 0x3E, 0x3E,
                0x6B, 0x4F, 0x6B, 0x3E, 0x1C, 0x3E, 0x7C, 0x3E, 0x1C, 0x18,
                0x3C, 0x7E, 0x3C, 0x18, 0x1C, 0x57, 0x7D, 0x57, 0x1C, 0x1C,
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                0x00, 0x3C, 0x3C, 0x3C, 0x3C, 0x00, 0x00, 0x00, 0x00, 0x00, };

static void
writeCommand(uint8_t c) {
    // wait until SSI2 not busy/transmit FIFO empty
    while ((SSI2_SR_R & SSI_SR_BSY) == SSI_SR_BSY) {
    };
    TFT_CS = TFT_CS_LOW;
    DC = DC_COMMAND;
    SSI2_DR_R = c;                        // data out
                                          // wait until SSI2 not busy/transmit FIFO empty
    while ((SSI2_SR_R & SSI_SR_BSY) == SSI_SR_BSY) {
    };
}

static void
writeData(uint8_t d) {
    while ((SSI2_SR_R & SSI_SR_TNF) == 0) {
    };   // wait until transmit FIFO not full
    DC = DC_DATA;
    SSI2_DR_R = d;                        // data out
}

void static
ILI9341_SetColor(uint32_t rgb) {
    /* // 18-bit, 6-6-6
     uint8_t r = (rgb & 0x3F0000) >> 16;
     uint8_t g = (rgb & 0x003F00) >> 8;
     uint8_t b = (rgb & 0x00003F);

     writeData(b << 2);
     writeData(g << 2);
     writeData(r << 2);

     */

    uint8_t r = (rgb & 0xF80000) >> 19;
    uint8_t g = (rgb & 0x00FC00) >> 10;
    uint8_t b = (rgb & 0x0000F8) >> 3;

    writeData((r << 3) | (g >> 3));
    writeData((g << 5) | (b));
}

void static
ILI9341_SetCoords(uint16_t x0, uint16_t y0, uint16_t x1, uint16_t y1) {
    y0 = ILI9341_TFTHEIGHT - y0;
    y1 = ILI9341_TFTHEIGHT - y1;
    uint16_t temp = y0;
    y0 = y1;
    y1 = temp;

    writeCommand(ILI9341_CASET); // Column addr set
    writeData(y0 >> 8);
    writeData(y0);     // YSTART
    writeData(y1 >> 8);
    writeData(y1);     // YEND

    writeCommand(ILI9341_PASET); // Row addr set
    writeData(x0 >> 8);
    writeData(x0);     // XSTART
    writeData(x1 >> 8);
    writeData(x1);     // XEND

    writeCommand(ILI9341_RAMWR);    // write to RAM
}

static void
deselect(void) {
    // wait until SSI2 not busy/transmit FIFO empty
    while ((SSI2_SR_R & SSI_SR_BSY) == SSI_SR_BSY) {
    };
    TFT_CS = TFT_CS_HIGH;
}

void
ILI9341_Init() {
    SYSCTL_RCGCSSI_R |= 0x04;  // activate SSI2
    SYSCTL_RCGCGPIO_R |= 0x01; // activate port A
    while ((SYSCTL_PRGPIO_R & 0x01) == 0) {
    }; // allow time for clock to start

    // toggle RST low to reset; CS low so it'll listen to us
    // SSI2Fss is temporarily used as GPIO
    GPIO_PORTA_DIR_R |= 0xC8;             // make PA3,6,7 out
    GPIO_PORTA_AFSEL_R &= ~0xC8;          // disable alt funct on PA3,6,7
    GPIO_PORTA_DEN_R |= 0xC8;             // enable digital I/O on PA3,6,7
                                          // configure PA3,6,7 as GPIO
    // configure PE5
    GPIO_PORTE_DIR_R |= 0x20;
    GPIO_PORTE_AFSEL_R &= ~0x20;
    GPIO_PORTE_DEN_R |= 0x20;

    GPIO_PORTA_PCTL_R = (GPIO_PORTA_PCTL_R & 0x00FF0FFF) + 0x00000000;
    GPIO_PORTA_AMSEL_R &= ~0xC8;      // disable analog functionality on PA3,6,7
    TFT_CS = TFT_CS_LOW;
    RESET = RESET_HIGH;
    Delay1ms(300);
    RESET = RESET_LOW;
    Delay1ms(300);
    RESET = RESET_HIGH;
    Delay1ms(300);

    // initialize SSI2
    GPIO_PORTB_AFSEL_R |= 0b10010000;           // enable alt funct on PB4, PB7
    GPIO_PORTB_DEN_R |= 0b10010000;             // enable digital I/O on PB4, PB7
                                          // configure PB4, PB7 as SSI
    GPIO_PORTB_PCTL_R = (GPIO_PORTB_PCTL_R & 0x0FF0FFFF) + 0x20020000;
    GPIO_PORTB_AMSEL_R &= ~0b10010000;      // disable analog functionality on PB4, PB7
    SSI2_CR1_R &= ~SSI_CR1_SSE;           // disable SSI
    SSI2_CR1_R &= ~SSI_CR1_MS;            // master mode
                                          // configure for system clock/PLL baud clock source
    SSI2_CC_R = (SSI2_CC_R & ~SSI_CC_CS_M) + SSI_CC_CS_SYSPLL;

    // SysClk/(CPSDVSR*(1+SCR))
    // 80/(10*(1+0)) = 8 MHz (slower than 4 MHz)
    SSI2_CPSR_R = (SSI2_CPSR_R&~SSI_CPSR_CPSDVSR_M)+6; // must be even number
    SSI2_CR0_R &= ~(SSI2_CR0_R |       // SCR = 0 (8 Mbps data rate)
            SSI_CR0_SPH |         // SPH = 0
            SSI_CR0_SPO);         // SPO = 0
                                  // FRF = Freescale format
    SSI2_CR0_R = (SSI2_CR0_R & ~SSI_CR0_FRF_M) + SSI_CR0_FRF_MOTO;
    // DSS = 8-bit data
    SSI2_CR0_R = (SSI2_CR0_R & ~SSI_CR0_DSS_M) + SSI_CR0_DSS_8;
    SSI2_CR1_R |= SSI_CR1_SSE;            // enable SSI

    commandList(cmd_ili9341);

    ILI9341_FillScreen(0);                 // set screen to black

    OS_InitSemaphore(&SPIFree, 1);         // means LCD free
}

// Companion code to the above tables.  Reads and issues
// a series of LCD commands stored in ROM byte array.
void
commandList(const uint8_t *addr) {

    uint8_t numCommands, numArgs;
    uint16_t ms;

    numCommands = *(addr++);               // Number of commands to follow
    while (numCommands--) {                 // For each command...
        writeCommand(*(addr++));             //   Read, issue command
        numArgs = *(addr++);                //   Number of args to follow
        ms = numArgs & DELAY;          //   If hibit set, delay follows args
        numArgs &= ~DELAY;                   //   Mask out delay bit
        while (numArgs--) {                   //   For each argument...
            writeData(*(addr++));              //     Read, issue argument
        }

        if (ms) {
            ms = *(addr++);             // Read post-command delay time (ms)
            if (ms == 255) ms = 500;     // If 255, delay for 500 ms
            Delay1ms(ms);
        }
    }
}

//  Bottom-left corner is (0, 0). Up = +y, Right = +x
void
ILI9341_DrawPixel(uint32_t x, uint32_t y, uint32_t rgb) {
    if ((x > ILI9341_TFTWIDTH) || (y > ILI9341_TFTHEIGHT)) return;



    ILI9341_SetCoords(x, y, x, y);

    ILI9341_SetColor(rgb);

    deselect();
    endSPITransaction();
}

//  Coordinate is left-most pixel of line
void
ILI9341_DrawHLine(uint32_t x, uint32_t y, uint32_t l, uint32_t rgb) {
    if ((x > ILI9341_TFTWIDTH) || (y > ILI9341_TFTHEIGHT)) return;
    if (x + l > ILI9341_TFTWIDTH) l = ILI9341_TFTWIDTH - x;



    ILI9341_SetCoords(x, y, x + l, y);

    for (uint32_t i = 0; i < l; i++) {
        ILI9341_SetColor(rgb);
    }
    deselect();
    endSPITransaction();
}

//  Coordinate is bottom pixel of line
void
ILI9341_DrawVLine(uint32_t x, uint32_t y, uint32_t l, uint32_t rgb) {
    if ((x > ILI9341_TFTWIDTH) || (y > ILI9341_TFTHEIGHT)) return;
    if (y + l > ILI9341_TFTHEIGHT) l = ILI9341_TFTHEIGHT - y;



    ILI9341_SetCoords(x, y, x, y + l);

    for (uint16_t i = 0; i < l; i++) {
        ILI9341_SetColor(rgb);
    }
    deselect();
    endSPITransaction();
}

void
ILI9341_DrawColors(uint32_t x, uint32_t y, int32_t *rgbArr,
        uint16_t totalPixels) {
    if ((x > ILI9341_TFTWIDTH) || (y > ILI9341_TFTHEIGHT)) return;

    if (x + totalPixels > ILI9341_TFTWIDTH) totalPixels = ILI9341_TFTWIDTH - x;



    ILI9341_SetCoords(x, y, x + totalPixels, y);

    for (uint32_t i = 0; i < totalPixels; i++) {
        ILI9341_SetColor(rgbArr[i]);
    }

    deselect();
}

//  Coordinate is left-most pixel of line
void
ILI9341_DrawHLineMulticolored(uint32_t x, uint32_t y, uint32_t *rgb,
        uint32_t *num, uint32_t n) {
    if ((x > ILI9341_TFTWIDTH) || (y > ILI9341_TFTHEIGHT)) return;

    uint32_t l = 0;
    for (int i = 0; i < n; i++) {
        l += num[i];
    }

    if (x + l >= ILI9341_TFTWIDTH) l = ILI9341_TFTWIDTH - x - 1;



    ILI9341_SetCoords(x, y, x + l, y);

    uint32_t j;
    uint32_t loops;
    for (int i = n - 1; i >= 0; i--) {
        loops = num[i];
        for (j = 0; j < loops && l-- > 0; j++) {
            ILI9341_SetColor(rgb[i]);
        }
    }
    deselect();
}

//  coordinate is bottom-left of rectangle
void
ILI9341_FillRect(uint32_t x, uint32_t y, uint32_t w, uint32_t h, uint32_t rgb) {
    if ((x > ILI9341_TFTWIDTH) || (y > ILI9341_TFTHEIGHT)) return;

    if (x + w >= ILI9341_TFTWIDTH) w = ILI9341_TFTWIDTH - x;
    if (y + h >= ILI9341_TFTHEIGHT) h = ILI9341_TFTHEIGHT - y;


    ILI9341_SetCoords(x, y, x + w, y + h);

    for (y = h; y > 0; y--) {
        for (x = w; x > 0; x--) {
            ILI9341_SetColor(rgb);
        }
    }
    deselect();
}

void
ILI9341_DrawCharS(int16_t x, int16_t y, char c, int16_t textColor,
        int16_t bgColor, uint8_t size) {
    uint8_t line; // vertical column of pixels of character in font
    int32_t i, j;
    if ((x >= ILI9341_TFTWIDTH) || // Clip right
            (y >= ILI9341_TFTHEIGHT) || // Clip bottom
            ((x + 6 * size - 1) < 0) || // Clip left
            ((y + 8 * size - 1) < 0))   // Clip top
        return;

    for (i = 0; i < 6; i++) {
        if (i == 5)
            line = 0x0;
        else
            line = Font[(c * 5) + i];
        for (j = 0; j < 8; j++) {
            if (line & 0x1) {
                if (size == 1) // default size
                    ILI9341_DrawPixel(x + i, y + j, textColor);
                else {  // big size
                    ILI9341_FillRect(x + (i * size), y + (j * size), size, size,
                            textColor);
                }
            } else if (bgColor != textColor) {
                if (size == 1) // default size
                    ILI9341_DrawPixel(x + i, y + j, bgColor);
                else {  // big size
                    ILI9341_FillRect(x + i * size, y + j * size, size, size,
                            bgColor);
                }
            }
            line >>= 1;
        }
    }
}

uint32_t
ILI9341_DrawString(uint16_t x, uint16_t y, char *pt, int16_t textColor) {
    uint32_t count = 0;
    if (y > 23) return 0;
    while (*pt) {
        ILI9341_DrawCharS(x * 6, y * 10, *pt, textColor, 0, 1);
        pt++;
        x = x + 1;
        if (x > 20) return count;  // number of characters printed
        count++;
    }
    return count;  // number of characters printed
}

void
ILI9341_ClearLine(uint16_t x, uint16_t y, int16_t textColor) {
    ILI9341_FillRect(x * 6, y * 10, ILI9341_TFTWIDTH, 8, textColor);
}

char buffer[40];
void
ILI9341_Message(uint32_t d, uint32_t l, char *pt, int32_t value) {
    OS_Wait(&SPIFree);
    int i = 0;

    // write this as part of Labs 1 and 2
    int8_t line = l;
    if (d == 1) {
        line += 12;
    }

    // copy pt string to buffer
    while (*pt) {
        buffer[i++] = *pt;
        pt++;
    }
    uint8_t count = itoa(value, buffer + i);
    buffer[i + count] = '\0';

    uint32_t charCount = ILI9341_DrawString(0, line, buffer, 0xFFFF);
    ILI9341_ClearLine(charCount, line, 0);
    OS_Signal(&SPIFree);
}

void
ILI9341_FillScreen(uint32_t rgb) {
    ILI9341_FillRect(0, 0, ILI9341_TFTWIDTH, ILI9341_TFTHEIGHT, rgb);
}

void
endSPITransaction(void) {
    while ((SSI2_SR_R & SSI_SR_BSY) == SSI_SR_BSY) {
    };
}
